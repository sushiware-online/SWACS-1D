## os/configs/swacs1d_defconfig
```kconfig
BR2_x86_64=y
BR2_TOOLCHAIN_BUILDROOT_MUSL=y
BR2_TOOLCHAIN_BUILDROOT_CXX=y
BR2_KERNEL_HEADERS_6_6=y
BR2_PACKAGE_HOST_RUSTC=y

# System
BR2_TARGET_GENERIC_GETTY_PORT="tty1"
BR2_SYSTEM_DHCP="eth0"
BR2_ROOTFS_DEVICE_CREATION_DYNAMIC_EUDEV=y
BR2_INIT_BUSYBOX=y

# Linux Kernel (THIS WAS MISSING!)
BR2_LINUX_KERNEL=y
BR2_LINUX_KERNEL_CUSTOM_VERSION=y
BR2_LINUX_KERNEL_CUSTOM_VERSION_VALUE="6.6.30"
BR2_LINUX_KERNEL_USE_ARCH_DEFAULT_CONFIG=y
BR2_LINUX_KERNEL_NEEDS_HOST_OPENSSL=y
BR2_LINUX_KERNEL_NEEDS_HOST_LIBELF=y
BR2_LINUX_KERNEL_CONFIG_FRAGMENT_FILES="board/swacs1d/kernel.fragment"

# X11 & Graphics
BR2_PACKAGE_XORG7=y
BR2_PACKAGE_XSERVER_XORG_SERVER=y
BR2_PACKAGE_XSERVER_XORG_SERVER_MODULAR=y
BR2_PACKAGE_XDRIVER_XF86_INPUT_EVDEV=y
BR2_PACKAGE_XAPP_XINIT=y
BR2_PACKAGE_XAPP_XAUTH=y      # Required for startx
BR2_PACKAGE_MCOOKIE=y         # Required for startx (generates auth cookie)
BR2_PACKAGE_XAPP_XMESSAGE=y
BR2_PACKAGE_XAPP_XRANDR=y
BR2_PACKAGE_XDRIVER_XF86_VIDEO_INTEL=y
BR2_PACKAGE_XDRIVER_XF86_VIDEO_AMDGPU=y
BR2_PACKAGE_XDRIVER_XF86_VIDEO_NOUVEAU=y
BR2_PACKAGE_XDRIVER_XF86_VIDEO_FBDEV=y
BR2_PACKAGE_XDRIVER_XF86_VIDEO_VESA=y
BR2_PACKAGE_MESA3D=y
BR2_PACKAGE_MESA3D_GALLIUM_DRIVER_IRIS=y
BR2_PACKAGE_MESA3D_GALLIUM_DRIVER_RADEONSI=y
BR2_PACKAGE_MESA3D_GALLIUM_DRIVER_NOUVEAU=y
BR2_PACKAGE_MESA3D_GBM=y

# SDL3
BR2_PACKAGE_SDL3=y
BR2_PACKAGE_SDL3_X11=y
BR2_PACKAGE_SDL3_KMSDRM=y
BR2_PACKAGE_SDL3_IMAGE=y
BR2_PACKAGE_SDL3_TTF=y
BR2_PACKAGE_SDL3_MIXER=y

# Multimedia
BR2_PACKAGE_FFMPEG=y
BR2_PACKAGE_FFMPEG_SWSCALE=y
BR2_PACKAGE_LIBVA=y
BR2_PACKAGE_INTEL_MEDIA_DRIVER=y
BR2_PACKAGE_ALSA_LIB=y
BR2_PACKAGE_ALSA_UTILS=y
BR2_PACKAGE_OPUSFILE=y
BR2_PACKAGE_LIBVORBIS=y
BR2_PACKAGE_FLAC=y

# Tools & Security
BR2_PACKAGE_GPTFDISK=y
BR2_PACKAGE_GPTFDISK_SGDISK=y
BR2_PACKAGE_E2FSPROGS=y
BR2_PACKAGE_CRYPTSETUP=y
BR2_PACKAGE_TPM2_TOOLS=y
BR2_PACKAGE_OPENSSL=y
BR2_PACKAGE_LIBOPENSSL_BIN=y
BR2_PACKAGE_JQ=y
BR2_PACKAGE_ZSTD=y

# Bootloader
BR2_TARGET_GRUB2=y
BR2_TARGET_GRUB2_X86_64_EFI=y
BR2_TARGET_GRUB2_BUILTIN_MODULES_EFI="boot linux ext2 fat squash4 part_gpt normal efi_gop chain shim_lock"

# Image Generation & Scripts
BR2_TARGET_ROOTFS_SQUASHFS=y
BR2_PACKAGE_HOST_GENIMAGE=y
BR2_PACKAGE_HOST_DOSFSTOOLS=y
BR2_PACKAGE_HOST_MTOOLS=y
BR2_ROOTFS_POST_IMAGE_SCRIPT="board/swacs1d/post-image.sh support/scripts/genimage.sh"
BR2_ROOTFS_POST_SCRIPT_ARGS="-c board/swacs1d/genimage.cfg"
BR2_ROOTFS_OVERLAY="board/swacs1d/rootfs_overlay"

# Build Speed
BR2_CCACHE=y

# Enable the Shim bootloader
BR2_PACKAGE_SHIM=y
```
